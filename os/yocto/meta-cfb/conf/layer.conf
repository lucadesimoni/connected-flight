## os/yocto/meta-cfb/conf/layer.conf
```bitbake
# Copyright (c) 2026 Outthinkx by Luca De Simoni. All rights reserved.
# Proprietary software, not open source. See LICENSE.
BBPATH .= ":${LAYERDIR}"
BBFILES += "${LAYERDIR}/recipes-*/*/*.bb ${LAYERDIR}/recipes-*/*/*.bbappend"
BBFILE_COLLECTIONS += "cfb"
BBFILE_PATTERN_cfb = "^${LAYERDIR}/"
BBFILE_PRIORITY_cfb = "10"
LAYERDEPENDS_cfb = "core raspberrypi rauc"
LAYERSERIES_COMPAT_cfb = "scarthgap"
```
